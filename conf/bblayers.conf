## conf/bblayers.conf
```bitbake
# LAYER_CONF_VERSION is increased each time build/conf/bblayers.conf
# changes incompatibly
LCONF_VERSION = "6"

BBPATH = "${TOPDIR}"
BBFILES ?= ""

BBLAYERS ?= " \
  {__PWD__}/meta-develer \
  {__PWD__}/meta-atmel \
  {__PWD__}/meta-qt5 \
  {__PWD__}/meta \
  {__PWD__}/meta-yocto \
  {__PWD__}/meta-yocto-bsp \
  {__PWD__}/meta-openembedded/meta-oe \
  {__PWD__}/meta-openembedded/meta-networking \
  {__PWD__}/meta-openembedded/meta-ruby \
  "
BBLAYERS_NON_REMOVABLE ?= " \
  {__PWD__}/meta \
  {__PWD__}/meta-yocto \
  "
```

## meta-develboard/conf/layer.conf
```bitbake
# We have a conf and classes directory, add to BBPATH
BBPATH .= ":${LAYERDIR}"

# We have recipes-* directories, add to BBFILES
BBFILES += "${LAYERDIR}/recipes-*/*/*.bb \
            ${LAYERDIR}/recipes-*/*/*.bbappend"

BBFILE_COLLECTIONS += "develboard"
BBFILE_PATTERN_develboard = "^${LAYERDIR}/"
BBFILE_PRIORITY_develboard = "5"
LAYERVERSION_develboard = "3"
```

## meta-develer/conf/machine/develboard.conf
```bitbake
#@TYPE: Machine
#@Name: DEVELER DEVELBOARD
#@DESCRIPTION: Machine configuration for Develer's develboard

require conf/machine/include/tune-cortexa5.inc
require conf/machine/include/bootloaders.inc

MACHINE_FEATURES = "apm alsa ext2 ext3 usbhost usbgadget screen camera can touchscreen ppp"

KERNEL_IMAGETYPE = "zImage"
KERNEL_DEVICETREE = " \
		at91-sama5d4_xplained.dtb \
		"

PREFERRED_PROVIDER_virtual/kernel = "linux-yocto-custom"
PREFERRED_PROVIDER_virtual/bootloader = "barebox"

PREFERRED_PROVIDER_jpeg = "jpeg"
PREFERRED_PROVIDER_jpeg-native = "jpeg-native"

ALLOW_EMPTY_qttools-plugins = "1"

DEFAULTTUNE = "cortexa5thf-neon"

# used by sysvinit_2
SERIAL_CONSOLE ?= "115200 ttyS0"

ROOT_FLASH_SIZE = "256"
IMAGE_FSTYPES += " ubi tar.gz"

# NAND
MKUBIFS_ARGS = " -e 0x3e000 -c 2082 -m 0x1000 -x lzo"
UBINIZE_ARGS = " -m 0x1000 -p 0x40000"

UBI_VOLNAME = "rootfs"

BAREBOX_MACHINE ?= "sama5d4_xplained_defconfig"

AT91BOOTSTRAP_MACHINE ?= "sama5d4_xplained"
AT91BOOTSTRAP_CONFIG ?= "sama5d4_xplainednf_uboot_secure"

DEVELBOARD_REV = "8f139cb2766a70ba9dfd74276973b57a34dc0ce6"
DEVELBOARD_HTTP = "https://raw.githubusercontent.com/develersrl/develboard/${DEVELBOARD_REV}"
DEVELBOARD_GIT = "git://github.com/develersrl/develboard.git;protocol=http;tag=${DEVELBOARD_REV}"
```
